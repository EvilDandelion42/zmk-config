// This file was generated from a template. Edit it to match your keyboard.
// See https://zmk.dev/docs/development/hardware-integration/new-shield for more
// instructions.

#include "myzarak.dtsi"

&default_transform {
    col-offset = <7>; // equal to the left side's total column count (0-6)
};

&kscan {
    row-gpios
        = <&pro_micro 21 (GPIO_ACTIVE_HIGH | GPIO_PULL_DOWN)>  // row0
        , <&pro_micro 20 (GPIO_ACTIVE_HIGH | GPIO_PULL_DOWN)>  // row1
        , <&pro_micro 14 (GPIO_ACTIVE_HIGH | GPIO_PULL_DOWN)>  // row2
        , <&pro_micro 18 (GPIO_ACTIVE_HIGH | GPIO_PULL_DOWN)>  // row3
        , <&pro_micro 19 (GPIO_ACTIVE_HIGH | GPIO_PULL_DOWN)>  // row4 (thumb)
        ;
    col-gpios
        = <&pro_micro 2 GPIO_ACTIVE_HIGH>   // col0
        , <&pro_micro 3 GPIO_ACTIVE_HIGH>   // col1
        , <&pro_micro 4 GPIO_ACTIVE_HIGH>   // col2
        , <&pro_micro 5 GPIO_ACTIVE_HIGH>   // col3
        , <&pro_micro 7 GPIO_ACTIVE_HIGH>   // col4
        , <&pro_micro 9 GPIO_ACTIVE_HIGH>   // col5
        , <&pro_micro 10 GPIO_ACTIVE_HIGH>  // col6 (dedicated inner thumb key)
        ;
};
