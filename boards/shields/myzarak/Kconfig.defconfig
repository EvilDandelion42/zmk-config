## boards/shields/myzarak/Kconfig.defconfig
```kconfig
if SHIELD_MYZARAK_LEFT

config ZMK_KEYBOARD_NAME
    default "myzarak"

config ZMK_SPLIT_ROLE_CENTRAL
    default y

endif # SHIELD_MYZARAK_LEFT

if SHIELD_MYZARAK_LEFT || SHIELD_MYZARAK_RIGHT

config ZMK_SPLIT
    default y

endif # SHIELD_MYZARAK_LEFT || SHIELD_MYZARAK_RIGHT
```

## boards/shields/myzarak/Kconfig.shield
```kconfig
config SHIELD_MYZARAK_LEFT
    def_bool $(shields_list_contains,myzarak_left)

config SHIELD_MYZARAK_RIGHT
    def_bool $(shields_list_contains,myzarak_right)
```
